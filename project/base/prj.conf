## CMakeLists.txt
```
# SPDX-License-Identifier: Apache-2.0

# SPDX-License-Identifier: Apache-2.0
#Setting to exclusively build for the dongle
set(BOARD nrf52840dongle_nrf52840)
set(CONF_FILE prj.conf bt.conf usb.conf shell.conf)

set(DTC_OVERLAY_FILE dtc_shell.overlay)

cmake_minimum_required(VERSION 3.20.0)
find_package(Zephyr REQUIRED HINTS $ENV{ZEPHYR_BASE})
project(ahu)

target_sources(app PRIVATE 
			src/main.c 
			../../oslib/base_drivers/base_ble/base_ble.c 
		)

#Add include_directories for libraries, path starts from this files location.
include_directories(
			inc/
                        ../../oslib/base_drivers/base_ble/
                       )



zephyr_library_include_directories(${ZEPHYR_BASE}/samples/bluetooth)
```

## prj.conf
```kconfig
CONFIG_GPIO=y
CONFIG_PRINTK=y
CONFIG_PWM=y
CONFIG_LOG=y
CONFIG_NEWLIB_LIBC=y 
```

## bt.conf
```kconfig
CONFIG_BT=y
CONFIG_BT_DEVICE_NAME="AllAboutThatBase"
CONFIG_BT_CENTRAL=y

#GATT
CONFIG_BT_DIS=y
CONFIG_BT_SMP=y

CONFIG_BT_CTLR_TX_PWR_PLUS_8=y

#Enable data signing which is used for transferring authenticated data in an unencrypted connection.
CONFIG_BT_SIGNING=y

CONFIG_BT_PERIPHERAL=y
CONFIG_BT_GATT_CLIENT=y
#CONFIG_BT_ATT_PREPARE_COUNT=2
CONFIG_BT_ATT_PREPARE_COUNT=10
```

## shell.conf
```kconfig
#-----------------------------SHELL_CONF--------------------------------------
CONFIG_SHELL_BACKEND_SERIAL_CHECK_DTR=y
CONFIG_UART_LINE_CTRL=y
CONFIG_SHELL_BACKEND_SERIAL_INIT_PRIORITY=51
CONFIG_SHELL=y
CONFIG_SHELL_BACKENDS=y
CONFIG_SHELL_BACKEND_SERIAL=y

CONFIG_SHELL_PROMPT_UART="SHELLY> "

CONFIG_SHELL_CMDS=y
CONFIG_SHELL_TAB=y
CONFIG_SHELL_TAB_AUTOCOMPLETION=y
CONFIG_SHELL_VT100_COLORS=y
CONFIG_KERNEL_SHELL=y
#-----------------------------------------------------------------------------

#-----------------------------SHELL_LOGGING-----------------------------------
CONFIG_LOG=y
CONFIG_LOG_PRINTK=y
#------------------------------
```

## usb.conf
```kconfig
#----------------------------------USB SETUP----------------------------------
CONFIG_USB_DEVICE_STACK=y
CONFIG_USB_DEVICE_PRODUCT="Zephyr USB shell + blinky"
#-----------------------------------------------------------------------------

#--------------------------------USB_OPTIONS----------------------------------
CONFIG_USB_DEVICE_PRODUCT="NRF Dongle"
CONFIG_USB_DEVICE_MANUFACTURER="Something Inc."
CONFIG_USB_DEVICE_VID=0xC553
CONFIG_USB_DEVICE_PID=0x4020
#-----------------------------------------------------------------------------
```

## dtc_shell.overlay
```dts
/ {
        chosen {
                zephyr,shell-uart = &cdc_acm_uart0;
        };
};

&zephyr_udc0 {
        cdc_acm_uart0: cdc_acm_uart0 {
                compatible = "zephyr,cdc-acm-uart";
                label = "CDC_ACM_0";
        };
};
```

## src/main.c
```c
/**
 * 
 * base node main.c file for project athena-green CSSE4011
 * 
 * Copyright Haoxi Tan & Geordie Pearson 2022
 */

#include <zephyr.h>
#include <sys/printk.h>
#include <drivers/gpio.h>
#include <usb/usb_device.h>
#include <drivers/uart.h>
#include <shell/shell.h>
#include <device.h>
#include <drivers/pwm.h>

#include <zephyr/types.h>

// string things
#include <stddef.h>
// #include <toolchain.h>
#include <logging/log.h>

#include <stdio.h>
#include <stdint.h>

#include "base_ble.h"

// init logging

/* Define logging module */

LOG_MODULE_REGISTER(base_module, LOG_LEVEL_DBG);



/* Debug Thread Stack size */
#define THREAD_BLE_LED_STACK 512
#define THREAD_BLE_BASE_STACK 4094
#define THREAD_BLE_JSON_STACK 4096
/* Debug Thread Priority */
#define THREAD_PRIORITY_BLE_LED 10
#define THREAD_PRIORITY_BLE_BASE -2
#define THREAD_PRIORITY_JSON_SAMPLING 5



void main(void)
{


    int ret;

	/* Setup DTR */
    // const struct device *shell_dev = DEVICE_DT_GET(DT_CHOSEN(zephyr_shell_uart));
    // uint32_t dtr = 0;

    /* Enable the USB Driver */
    if (usb_enable(NULL))  { // if this doesn succeed no LED0 will be on
    	return;
    }
    led_init();

   
	// while (1) {
	// 	// ret = gpio_pin_toggle_dt(&led);
	// 	gpio_pin_set_dt(&led, 1);
	// 	// if (ret < 0) {
	// 		// return;
	// 	// }
	// 	k_msleep(SLEEP_TIME_MS);
	// }
}



K_THREAD_DEFINE(ble_base, THREAD_BLE_BASE_STACK, thread_ble_base, NULL, NULL, NULL, THREAD_PRIORITY_BLE_BASE, 0, 0);
// K_THREAD_DEFINE(ble_led, THREAD_BLE_LED_STACK, thread_ble_led, NULL, NULL, NULL, THREAD_PRIORITY_BLE_LED, 0, 0);
// K_THREAD_DEFINE(ble_json_sampling, THREAD_BLE_JSON_STACK, thread_ble_json_output, NULL, NULL, NULL, THREAD_PRIORITY_JSON_SAMPLING, 0, 0);
```
